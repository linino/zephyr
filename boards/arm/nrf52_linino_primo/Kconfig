## boards/arm/nrf52_linino_primo/Kconfig
```kconfig
# Kconfig - Linino Primo board configuration
#
# Copyright (c) 2018 Linino org
#
# SPDX-License-Identifier: Apache-2.0

if BOARD_NRF52_LININO_PRIMO

config BOARD_ENABLE_DCDC
	bool "Enable DCDC mode"
	select SOC_DCDC_NRF52X
	default y

endif # BOARD_NRF52_LININO_PRIMO
```

## boards/arm/nrf52_linino_primo/Kconfig.board
```kconfig
# Kconfig - Linino Primo board configuration
#
# Copyright (c) 2018 Linino org
#
# SPDX-License-Identifier: Apache-2.0

config  BOARD_NRF52_LININO_PRIMO
	bool "nRF52 LININO PRIMO"
	depends on SOC_NRF52832_QFAA
```

## boards/arm/nrf52_linino_primo/Kconfig.defconfig
```kconfig
# Kconfig - Linino Primo board configuration
#
# Copyright (c) 2018 Linino org
#
# SPDX-License-Identifier: Apache-2.0

if BOARD_NRF52_LININO_PRIMO

config BOARD
	default "nrf52_linino_primo"

endif # BOARD_NRF52_LININO_PRIMO
```

## boards/arm/nrf52_primo/Kconfig
```kconfig
# Kconfig - nRF52 PRIMO board configuration
#
# Copyright (c) 2016 Nordic Semiconductor ASA
# Copyright (c) 2018 dog hunter LLC and the Linino community
#
# Linino.org is a dog hunter sponsored community project
#
# This file comes from nrf52_pca10040 board's Kconfig and was patched by
# Davide Ciminaghi <davide@linino.org> and Jeff Wu <jeff@doghunter.org>
#
#
# SPDX-License-Identifier: Apache-2.0

if BOARD_NRF52_PRIMO

config BOARD_ENABLE_DCDC
	bool "Enable DCDC mode"
	select SOC_DCDC_NRF52X
	default y

endif # BOARD_NRF52_PRIMO
```

## boards/arm/nrf52_primo/Kconfig.board
```kconfig
# Kconfig - nRF52 PRIMO board configuration
#
# Copyright (c) 2016 Nordic Semiconductor ASA
# Copyright (c) 2018 dog hunter LLC and the Linino community
#
# Linino.org is a dog hunter sponsored community project
#
# This file comes from nrf52_pca10040's Kconfig.board and was patched by
# Davide Ciminaghi <davide@linino.org> and Jeff Wu <jeff@doghunter.org>
#
# SPDX-License-Identifier: Apache-2.0

config  BOARD_NRF52_PRIMO
	bool "nRF52 Primo"
	depends on SOC_NRF52832_QFAA
```

## boards/arm/nrf52_primo/Kconfig.defconfig
```kconfig
# Kconfig - nRF52 PRIMO board configuration
#
# Copyright (c) 2016 Nordic Semiconductor ASA
# Copyright (c) 2018 dog hunter LLC and the Linino community
#
# Linino.org is a dog hunter sponsored community project
#
# This file comes from nrf52_pca10040's Kconfig.defconfig and was patched by
# Davide Ciminaghi <davide@linino.org> and Jeff Wu <jeff@doghunter.org>
#
# SPDX-License-Identifier: Apache-2.0

if BOARD_NRF52_PRIMO

config BOARD
	default "nrf52_primo"

endif # BOARD_NRF52_PRIMO
```

## boards/arm/nrf52_primo/nrf52_primo_defconfig
```kconfig
CONFIG_ARM=y
CONFIG_SOC_FAMILY_NRF=y
CONFIG_SOC_SERIES_NRF52X=y
CONFIG_SOC_NRF52832_QFAA=y
CONFIG_BOARD_NRF52_PRIMO=y

# Enable MPU
CONFIG_ARM_MPU=y

# enable uart driver
CONFIG_SERIAL=y
CONFIG_UART_NRFX=y
CONFIG_UART_0_NRF_UART=y

# enable console
CONFIG_CONSOLE=y
CONFIG_UART_CONSOLE=y

# additional board options
CONFIG_GPIO_AS_PINRESET=y

# bluetooth
CONFIG_BT=y
CONFIG_BT_CTLR=y

# spi
CONFIG_SPI=y
CONFIG_SPI_NRFX=y
CONFIG_SPI_SLAVE=y
CONFIG_SPI_0=y
CONFIG_SPI_0_OP_MODES=2
CONFIG_SPI_0_NRF_ORC=0xaa
```

## boards/arm/nrf52_primo_mini/Kconfig.defconfig
```kconfig
# Kconfig - nRF52 PRIMO board configuration
#
# Copyright (c) 2016 Nordic Semiconductor ASA
# Copyright (c) 2018 dog hunter LLC and the Linino community
#
# Linino.org is a dog hunter sponsored community project
#
# This file comes from nrf52_pca10040's Kconfig.defconfig and was patched by
# Davide Ciminaghi <davide@linino.org> and Jeff Wu <jeff@doghunter.org>
#
# SPDX-License-Identifier: Apache-2.0

if BOARD_NRF52_PRIMO_MINI

config BOARD
	default "nrf52_primo_mini"

endif # BOARD_NRF52_PRIMO_MINI
```

## boards/arm/nrf52_primo_mini_evb/Kconfig.board
```kconfig
# Kconfig - nRF52 PRIMO MINI EVB board configuration
#
# Copyright (c) 2016 Nordic Semiconductor ASA
# Copyright (c) 2018 dog hunter LLC and the Linino community
#
# Linino.org is a dog hunter sponsored community project
#
# This file comes from nrf52_pca10040's Kconfig.board and was patched by
# Davide Ciminaghi <davide@linino.org> and Jeff Wu <jeff@doghunter.org>
#
# SPDX-License-Identifier: Apache-2.0

config  BOARD_NRF52_PRIMO_MINI_EVB
	bool "nRF52 Primo Mini EVB"
	depends on SOC_NRF52840_QIAA
```

## drivers/display/Kconfig.ws-epaper
```kconfig
# Kconfig - Waveshare e-paper display controller configuration options

#
# Copyright (c) 2018 Phytec Messtechnik GmbH
#
# SPDX-License-Identifier: Apache-2.0
#

menuconfig WS_EPAPER
	bool "Waveshare display driver"
	depends on SPI
	select DISPLAY_UTIL
	help
	  Enable driver for Waveshare e-paper display driver.
```

## drivers/wifi/esp8266-spi/Kconfig.esp8266-spi
```kconfig
# Kconfig - esp8266-spi WiFi driver options

#
# Copyright (c) 2018 WhatsNext gmbh
# Author: Davide Ciminaghi <davide@linino.org>
#
# SPDX-License-Identifier: Apache-2.0
#

menuconfig WIFI_ESP8266_SPI
	bool "ESP866 via spi WiFi driver support"
	depends on WIFI
	select WIFI_OFFLOAD
	select NET_L2_WIFI_MGMT

if WIFI_ESP8266_SPI

config WIFI_ESP8266_SPI_NAME
	string "Driver name"
	default "esp8266-spi"

config WIFI_ESP8266_SPI_MAX_PACKET_SIZE
	int "Maximum size of a packet, in bytes"
	default 1472
	help
	 Set the maximum size of a network packet going through the chip.
	 This sets the size of each buffer, in each buffer pool.
	 Do not modify it unless you know what you are doing.

endif # WIFI_ESP8266_SPI
```

## drivers/wifi/spi-ipc-wifi/Kconfig.spi-ipc-wifi
```kconfig
# Kconfig - esp8266-spi WiFi driver options

#
# Copyright (c) 2018 WhatsNext gmbh
# Author: Davide Ciminaghi <davide@linino.org>
#
# SPDX-License-Identifier: Apache-2.0
#

menuconfig WIFI_SPI_IPC
	bool "spi-ipc WiFi driver support"
	depends on WIFI
	depends on SPI_IPC_ETHERNET
	depends on SPI_IPC_WIFI_MGMT
	select NET_L2_WIFI
```

## dts/bindings/display/ws,epaper.yaml
```yaml
#
# Copyright (c) 2019, dog hunter LLC and the Linino community
#
# SPDX-License-Identifier: Apache-2.0
#
---
title: WAVESHARE E-PAPER Dot Matrix Display Controller
version: 0.1

description: >
    This is a representation of the WaveShare e-paper EPD display controller

inherits:
    !include spi-device.yaml

properties:
    compatible:
      constraint: "ws,e-paper"

    yres:
      type: int
      category: required
      description: vertical resolution in pixels
      generation:  define

    xres:
      type: int
      category: required
      description: horizontal resolution
      generation: define

    dc-gpios:
      type: compound
      category: required
      description: command/data gpio
      generation: define, use-prop-name

    reset-gpios:
      type: compound
      category: required
      description: reset gpio
      generation: define, use-prop-name

    busy-gpios:
      type: compound
      description: busy gpio
      generation: define, use-prop-name

...
```

## dts/bindings/spi/spi-ipc-wifi.yaml
```yaml
#
# Copyright (c) 2019, Dog Hunter LLC and the Linino community
#
# SPDX-License-Identifier: Apache-2.0
#
---
title: SPI-IPC wifi virtual device
version: 0.1

description: >
    This binding gives a representation of a spi-ipc wifi virtual device

properties:
     compatible:
      type: string
      category: required
      description: compatible strings
      generation: define
      constraint: "spi-ipc-wifi"
...
```

## dts/bindings/spi/spi-ipc.yaml
```yaml
#
# Copyright (c) 2019, Dog Hunter LLC and the Linino community
#
# SPDX-License-Identifier: Apache-2.0
#
---
title: SPI-IPC device
version: 0.1

description: >
    This binding gives a representation of a generic spi-ipc (inter processor
    communication over spi) device

inherits:
    !include spi-device.yaml

#child:
#     bus: spi-ipc

properties:
    compatible:
      type: string
      category: required
      description: compatible strings
      generation: define
      constraint: "spi-ipc"
    label:
      type: string
      category: required
      description: Human readable string describing the device (used by Zephyr for API name)
      generation: define
    poll-request-gpios:
      type: compound
      category: required
      generation: define, use-prop-name
...
```

## dts/bindings/wifi/doghunter,esp8266-primo.yaml
```yaml
#
# Copyright (c) 2018, Linaro Limited
#
# SPDX-License-Identifier: Apache-2.0
#
---
title: ESP8266 WiFi module on Doghunter Primo board
version: 0.1

description: >
    This binding gives the base representation of the Doghunter Primo ESP8266 WiFi module

inherits:
    !include spi-device.yaml

properties:
    compatible:
      constraint: "doghunter,esp8266-primo"

    poll-request-gpios:
      type: compound
      category: required
      generation: define, use-prop-name

    cs-gpios:
      type: compound
      category: required
      generation: define, use-prop-name
```

## subsys/spi-ipc/Kconfig
```kconfig
menuconfig SPI_IPC
	bool "SPI inter-processor communication infrastructure"
	help
	  Get two or more processors to work over spi in a standard way

if SPI_IPC

menuconfig SPI_IPC_THREAD_PRIO
	int "Priority of spi-ipc thread"
	default 2
	help
	  Priority of spi-ipc thread

menuconfig SPI_IPC_ETHERNET
	bool "Enable ethernet over spi ipc"
	help
	  Let a remote processor work as an ethernet interface


menuconfig SPI_IPC_WIFI_MGMT
	bool "Enable wifi management over spi ipc"
	help
	  Allow a remote processor to take care of wifi management functionalities

menuconfig SPI_IPC_MGMT
	bool "Low level spi-ipc management (alive frames)"
	default y
	help
	  Say yes if you want support for low level spi-ipc management protocol

endif
```
